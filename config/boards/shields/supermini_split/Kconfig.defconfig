## config/boards/shields/supermini_split/Kconfig.defconfig
```kconfig
if SHIELD_SUPERMINI_SPLIT_LEFT
config ZMK_KEYBOARD_NAME
default "SuperMiniSplit"
endif
if SHIELD_SUPERMINI_SPLIT_RIGHT
config ZMK_SPLIT_ROLE_CENTRAL
default n
endif
```
