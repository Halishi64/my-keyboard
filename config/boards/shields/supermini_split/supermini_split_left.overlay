#include "supermini_split.dtsi"

/ {
    kscan0: kscan {
        compatible = "zmk,kscan-gpio-direct";
        label = "KSCAN";
        input-gpios
            // 1 ряд: 022, 020, 017, 008, 006
            = <&gpio0 22 (GPIO_ACTIVE_LOW | GPIO_PULL_UP)>
            , <&gpio0 20 (GPIO_ACTIVE_LOW | GPIO_PULL_UP)>
            , <&gpio0 17 (GPIO_ACTIVE_LOW | GPIO_PULL_UP)>
            , <&gpio0 8  (GPIO_ACTIVE_LOW | GPIO_PULL_UP)>
            , <&gpio0 6  (GPIO_ACTIVE_LOW | GPIO_PULL_UP)>
            
            // 2 ряд: 106, 104, 011, 100, 024
            , <&gpio1 6  (GPIO_ACTIVE_LOW | GPIO_PULL_UP)>
            , <&gpio1 4  (GPIO_ACTIVE_LOW | GPIO_PULL_UP)>
            , <&gpio0 11 (GPIO_ACTIVE_LOW | GPIO_PULL_UP)>
            , <&gpio1 0  (GPIO_ACTIVE_LOW | GPIO_PULL_UP)>
            , <&gpio0 24 (GPIO_ACTIVE_LOW | GPIO_PULL_UP)>
            
            // 3 ряд: 115, 113, 111, 010 , 009
            , <&gpio1 15 (GPIO_ACTIVE_LOW | GPIO_PULL_UP)>
            , <&gpio1 13 (GPIO_ACTIVE_LOW | GPIO_PULL_UP)>
            , <&gpio1 11 (GPIO_ACTIVE_LOW | GPIO_PULL_UP)>
            , <&gpio0 10 (GPIO_ACTIVE_LOW | GPIO_PULL_UP)> 
            , <&gpio0 9  (GPIO_ACTIVE_LOW | GPIO_PULL_UP)>
            
            // Великий палець: 107, 002, 029, 031
            , <&gpio1 7  (GPIO_ACTIVE_LOW | GPIO_PULL_UP)>
            , <&gpio0 2  (GPIO_ACTIVE_LOW | GPIO_PULL_UP)>
            , <&gpio0 29 (GPIO_ACTIVE_LOW | GPIO_PULL_UP)>
            , <&gpio0 31 (GPIO_ACTIVE_LOW | GPIO_PULL_UP)>
            ;
    };
};
