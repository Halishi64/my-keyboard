#include "supermini_split.dtsi"

&default_transform {
    col-offset = <19>;
};

/ {
    kscan0: kscan {
        compatible = "zmk,kscan-gpio-direct";
        label = "KSCAN";
        input-gpios
            // 1 ряд 
            = <&gpio0 6  (GPIO_ACTIVE_LOW | GPIO_PULL_UP)>
            , <&gpio0 8  (GPIO_ACTIVE_LOW | GPIO_PULL_UP)>
            , <&gpio0 17 (GPIO_ACTIVE_LOW | GPIO_PULL_UP)>
            , <&gpio0 20 (GPIO_ACTIVE_LOW | GPIO_PULL_UP)>
            , <&gpio0 22 (GPIO_ACTIVE_LOW | GPIO_PULL_UP)>
            
            // 2 ряд 
            , <&gpio0 24 (GPIO_ACTIVE_LOW | GPIO_PULL_UP)>
            , <&gpio1 0  (GPIO_ACTIVE_LOW | GPIO_PULL_UP)>
            , <&gpio0 11 (GPIO_ACTIVE_LOW | GPIO_PULL_UP)>
            , <&gpio1 4  (GPIO_ACTIVE_LOW | GPIO_PULL_UP)>
            , <&gpio1 6  (GPIO_ACTIVE_LOW | GPIO_PULL_UP)>
            
            // 3 ряд 
            , <&gpio0 9  (GPIO_ACTIVE_LOW | GPIO_PULL_UP)>
            , <&gpio0 10 (GPIO_ACTIVE_LOW | GPIO_PULL_UP)>
            , <&gpio1 11 (GPIO_ACTIVE_LOW | GPIO_PULL_UP)>
            , <&gpio1 13 (GPIO_ACTIVE_LOW | GPIO_PULL_UP)>
            , <&gpio1 15 (GPIO_ACTIVE_LOW | GPIO_PULL_UP)>
            
            // Великий палець 
            , <&gpio0 31 (GPIO_ACTIVE_LOW | GPIO_PULL_UP)>
            , <&gpio0 29 (GPIO_ACTIVE_LOW | GPIO_PULL_UP)>
            , <&gpio0 2  (GPIO_ACTIVE_LOW | GPIO_PULL_UP)>
            , <&gpio1 7  (GPIO_ACTIVE_LOW | GPIO_PULL_UP)>
            ;
    };
};
